## sdkconfig.defaults
```kconfig
CONFIG_ENABLE_TEST_PATTERN=n
CONFIG_OV2640_SUPPORT=y
CONFIG_OV7725_SUPPORT=n
CONFIG_ESP32_DEFAULT_CPU_FREQ_240=y
CONFIG_ESP32_DEFAULT_CPU_FREQ_MHZ=240
CONFIG_MEMMAP_SMP=y
CONFIG_TASK_WDT=n
CONFIG_FREERTOS_UNICORE=n
CONFIG_FREERTOS_HZ=100

# long filenames for date stamping files
CONFIG_FATFS_LFN_NONE=
CONFIG_FATFS_LFN_HEAP=y

# faster flash
ESPTOOLPY_BAUD_115200=n
ESPTOOLPY_BAUD_2MB=y

# test on CORE1 too
CONFIG_CAMERA_CORE0=y

# spiram settings are important
CONFIG_SPIRAM_SUPPORT=y
CONFIG_SPIRAM_USE_MALLOC=y
CONFIG_SPIRAM_TYPE_AUTO=y

CONFIG_CXX_EXCEPTIONS=y

CONFIG_STACK_CHECK_NORM=y

# just to avoid compiler error
MBEDTLS_PSK_MODES=y
```
